## Kconfig
```kconfig
config TORABO_INPUT_THROTTLE
    bool "Torabo input throttle proxy"
    depends on INPUT
```

## boards/shields/torabo_tsuki_lp/Kconfig.defconfig
```kconfig
if SHIELD_TORABO_TSUKI_LP_LEFT || SHIELD_TORABO_TSUKI_LP_RIGHT

config ZMK_KEYBOARD_NAME
    default "torabo-tsuki"

config ZMK_SPLIT
    default y

config SPI
    default y

config INPUT
    default y

config ZMK_MOUSE
    default y

endif

if SHIELD_TORABO_TSUKI_LP_DONGLE

config ZMK_KEYBOARD_NAME
    default "torabo-tsuki"

config ZMK_SPLIT
    default y

config INPUT
    default y

config ZMK_MOUSE
    default y

config ZMK_SPLIT_BLE_CENTRAL_PERIPHERALS
    default 2

config BT_MAX_CONN
    default 7

config BT_MAX_PAIRED
    default 7

endif
```

## dts/bindings/input/torabo,input-throttle.yaml
```yaml
description: Torabo input throttle proxy

compatible: "torabo,input-throttle"

include: base.yaml

properties:
  source:
    type: phandle
    required: true
    description: Source input device to aggregate and forward.

  throttle-interval-ms:
    type: int
    default: 30
    description: Relative event aggregation interval in milliseconds.
```
