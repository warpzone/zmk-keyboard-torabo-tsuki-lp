#include "torabo_tsuki_lp_lr.dtsi"
#include <input/processors.dtsi>
#include <dt-bindings/zmk/input_transform.h>
#include "torabo_tsuki_lp_pointing.dtsi"

&pointing_listener {
    TORABO_TRACKBALL_INPUT_PROCESSORS
};
