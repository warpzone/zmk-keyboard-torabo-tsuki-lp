#include <input/processors.dtsi>
#include <dt-bindings/zmk/input_transform.h>
#include "torabo_tsuki_lp_common.dtsi"
#include "torabo_tsuki_lp_pointing.dtsi"

/ {
    chosen {
        zmk,kscan = &mock_kscan;
    };

    mock_kscan: mock_kscan_0 {
        compatible = "zmk,kscan-mock";
        columns = <0>;
        rows = <0>;
        events = <0>;
    };
};

&physical_layout_s {
    kscan = <&mock_kscan>;
};

&physical_layout_m {
    kscan = <&mock_kscan>;
};

&physical_layout_l {
    kscan = <&mock_kscan>;
};

/ {
    split_inputs {
        #address-cells = <1>;
        #size-cells = <0>;

        /* reg 0: right peripheral trackball (input-split / input-split-throttled) */
        pointing_device_split: pointing_device_split@0 {
            compatible = "zmk,input-split";
            reg = <0>;
        };

        /* reg 1: left peripheral trackpad (input-split-secondary) */
        pointing_device_split_secondary: pointing_device_split@1 {
            compatible = "zmk,input-split";
            reg = <1>;
        };
    };

    /* Trackball (reg 0): shaped here on the central, see torabo_tsuki_lp_pointing.dtsi */
    pointing_device_split_listener: pointing_device_split_listener {
        compatible = "zmk,input-listener";
        device = <&pointing_device_split>;
        status = "okay";
        TORABO_TRACKBALL_INPUT_PROCESSORS
    };

    /*
     * Trackpad (reg 1): no input-processors on purpose. The IQS7211E driver
     * runs on the left peripheral in scroller-mode (+v-invert) and already
     * emits final scroll events, so the central just forwards them.
     */
    pointing_device_split_listener_secondary: pointing_device_split_listener_secondary {
        compatible = "zmk,input-listener";
        device = <&pointing_device_split_secondary>;
        status = "okay";
    };
};
