#define TORABO_TSUKI_LP_RIGHT 1

#include "torabo_tsuki_lp_lr.dtsi"
#include <input/processors.dtsi>
#include <dt-bindings/zmk/input_transform.h>
#include "torabo_tsuki_lp_pointing.dtsi"

&pointing_listener {
    TORABO_TRACKBALL_INPUT_PROCESSORS
};

&size_s_transform {
    col-offset = <7>;
};

&size_m_transform {
    col-offset = <7>;
};

&size_l_transform {
    col-offset = <7>;
};
