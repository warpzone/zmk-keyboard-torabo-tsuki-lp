/*
 * Rate-limited variant of the upstream `input-split` snippet (reg 0).
 *
 * Instead of forwarding the raw pointing device straight to the split BLE
 * link, it inserts a `torabo,input-throttle` proxy that aggregates motion and
 * re-emits it non-blocking (K_NO_WAIT) at a fixed cadence. This keeps a
 * high-report-rate sensor (the right trackball) from saturating the split
 * forward path. See src/input_throttle.c.
 *
 * `source` is this board's local `pointing_device`. This snippet and
 * `input-split-secondary-throttled` are applied to *different* peripheral
 * builds (this one to the right trackball, the other to the left trackpad),
 * so although both reference the `pointing_device` label there is never more
 * than one throttle instance bound to a given device in a single binary.
 */
/ {
    pointing_device_throttled: pointing_device_throttled {
        compatible = "torabo,input-throttle";
        source = <&pointing_device>;
        throttle-interval-ms = <30>;
    };

    split_inputs {
        #address-cells = <1>;
        #size-cells = <0>;

        pointing_device_split: pointing_device_split@0 {
            compatible = "zmk,input-split";
            reg = <0>;
            device = <&pointing_device_throttled>;
        };
    };
};
