/*
 * Second remote pointing device on a split central (reg 1).
 *
 * Additive to the upstream `input-split` snippet (reg 0): use this on the
 * peripheral whose pointing device is aggregated alongside another one, i.e.
 * when a sensor-less dongle receives pointing input from two peripherals.
 * In this keyboard: the left trackpad peripheral in the dongle builds.
 */
/{
    split_inputs {
        #address-cells = <1>;
        #size-cells = <0>;

        pointing_device_split_secondary: pointing_device_split@1 {
            compatible = "zmk,input-split";
            reg = <1>;
            device = <&pointing_device>;
        };
    };
};
