/*
 * Rate-limited variant of `input-split-secondary` (reg 1).
 *
 * Same idea as `input-split-throttled` but for the second remote pointing
 * device (reg 1): a `torabo,input-throttle` proxy aggregates the source
 * device's relative motion and re-emits it non-blocking (K_NO_WAIT) at a
 * fixed cadence, keeping it from saturating the split forward path.
 * In this keyboard: the left trackpad peripheral in the dongle builds.
 * See src/input_throttle.c.
 *
 * `source` is this board's local `pointing_device`. This snippet and
 * `input-split-throttled` are applied to *different* peripheral builds (this
 * one to the left trackpad, the other to the right trackball), so although
 * both reference the `pointing_device` label there is never more than one
 * throttle instance bound to a given device in a single binary.
 */
/ {
    pointing_device_secondary_throttled: pointing_device_secondary_throttled {
        compatible = "torabo,input-throttle";
        source = <&pointing_device>;
        throttle-interval-ms = <30>;
    };

    split_inputs {
        #address-cells = <1>;
        #size-cells = <0>;

        pointing_device_split_secondary: pointing_device_split@1 {
            compatible = "zmk,input-split";
            reg = <1>;
            device = <&pointing_device_secondary_throttled>;
        };
    };
};
